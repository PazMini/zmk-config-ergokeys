## config/boards/shields/Kconfig.shield
```kconfig
config SHIELD_ERGOKEYS_LEFT
    def_bool $(shields_list_contains,ErgoKeys_left)

config SHIELD_ERGOKEYS_RIGHT
    def_bool $(shields_list_contains,ErgoKeys_right)
```
